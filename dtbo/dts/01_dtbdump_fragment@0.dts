/dts-v1/;

/ {

	fragment@0 {
		target = <0xffffffff>;

		__overlay__ {

			cam0@0 {
				phandle = <0x02>;

				pins_cmd_dat {
					pinmux = <0x1400>;
					slew-rate = <0x01>;
					output-low;
				};
			};

			cam0@1 {
				phandle = <0x03>;

				pins_cmd_dat {
					pinmux = <0x1400>;
					slew-rate = <0x01>;
					output-high;
				};
			};

			cam0@2 {
				phandle = <0x04>;

				pins_cmd_dat {
					pinmux = <0x1100>;
					slew-rate = <0x01>;
					output-low;
				};
			};

			cam0@3 {
				phandle = <0x05>;

				pins_cmd_dat {
					pinmux = <0x1100>;
					slew-rate = <0x01>;
					output-high;
				};
			};

			cam1@0 {
				phandle = <0x06>;

				pins_cmd_dat {
					pinmux = <0x1000>;
					slew-rate = <0x01>;
					output-low;
				};
			};

			cam1@1 {
				phandle = <0x07>;

				pins_cmd_dat {
					pinmux = <0x1000>;
					slew-rate = <0x01>;
					output-high;
				};
			};

			cam1@2 {
				phandle = <0x08>;

				pins_cmd_dat {
					pinmux = <0x1500>;
					slew-rate = <0x01>;
					output-low;
				};
			};

			cam1@3 {
				phandle = <0x09>;

				pins_cmd_dat {
					pinmux = <0x1500>;
					slew-rate = <0x01>;
					output-high;
				};
			};

			cam3@0 {
				phandle = <0x0e>;

				pins_cmd_dat {
					pinmux = <0x1200>;
					slew-rate = <0x01>;
					output-low;
				};
			};

			cam3@1 {
				phandle = <0x0f>;

				pins_cmd_dat {
					pinmux = <0x1200>;
					slew-rate = <0x01>;
					output-high;
				};
			};

			cam3@2 {
				phandle = <0x10>;

				pins_cmd_dat {
					pinmux = <0x9c00>;
					slew-rate = <0x01>;
					output-low;
				};
			};

			cam3@3 {
				phandle = <0x11>;

				pins_cmd_dat {
					pinmux = <0x9c00>;
					slew-rate = <0x01>;
					output-high;
				};
			};

			cam2@0 {
				phandle = <0x0a>;

				pins_cmd_dat {
					pinmux = <0x1600>;
					slew-rate = <0x01>;
					output-low;
				};
			};

			cam2@1 {
				phandle = <0x0b>;

				pins_cmd_dat {
					pinmux = <0x1600>;
					slew-rate = <0x01>;
					output-high;
				};
			};

			cam2@2 {
				phandle = <0x0c>;

				pins_cmd_dat {
					pinmux = <0x1300>;
					slew-rate = <0x01>;
					output-low;
				};
			};

			cam2@3 {
				phandle = <0x0d>;

				pins_cmd_dat {
					pinmux = <0x1300>;
					slew-rate = <0x01>;
					output-high;
				};
			};

			camera_pins_cam0_mclk_off {
				phandle = <0x12>;

				pins_cmd_dat {
					pinmux = <0x8000>;
					drive-strength = <0x01>;
				};
			};

			camera_pins_cam0_mclk_2ma {
				phandle = <0x13>;

				pins_cmd_dat {
					pinmux = <0x8001>;
					drive-strength = <0x00>;
				};
			};

			camera_pins_cam0_mclk_4ma {
				phandle = <0x14>;

				pins_cmd_dat {
					pinmux = <0x8001>;
					drive-strength = <0x01>;
				};
			};

			camera_pins_cam0_mclk_6ma {
				phandle = <0x15>;

				pins_cmd_dat {
					pinmux = <0x8001>;
					drive-strength = <0x02>;
				};
			};

			camera_pins_cam0_mclk_8ma {
				phandle = <0x16>;

				pins_cmd_dat {
					pinmux = <0x8001>;
					drive-strength = <0x03>;
				};
			};

			camera_pins_cam1_mclk_off {
				phandle = <0x17>;

				pins_cmd_dat {
					pinmux = <0x7e00>;
					drive-strength = <0x01>;
				};
			};

			camera_pins_cam1_mclk_2ma {
				phandle = <0x18>;

				pins_cmd_dat {
					pinmux = <0x7e01>;
					drive-strength = <0x00>;
				};
			};

			camera_pins_cam1_mclk_4ma {
				phandle = <0x19>;

				pins_cmd_dat {
					pinmux = <0x7e01>;
					drive-strength = <0x01>;
				};
			};

			camera_pins_cam1_mclk_6ma {
				phandle = <0x1a>;

				pins_cmd_dat {
					pinmux = <0x7e01>;
					drive-strength = <0x02>;
				};
			};

			camera_pins_cam1_mclk_8ma {
				phandle = <0x1b>;

				pins_cmd_dat {
					pinmux = <0x7e01>;
					drive-strength = <0x03>;
				};
			};

			camera_pins_cam3_mclk_off {
				phandle = <0x21>;

				pins_cmd_dat {
					pinmux = <0x7f00>;
					drive-strength = <0x01>;
				};
			};

			camera_pins_cam3_mclk_2ma {
				phandle = <0x22>;

				pins_cmd_dat {
					pinmux = <0x7f01>;
					drive-strength = <0x00>;
				};
			};

			camera_pins_cam3_mclk_4ma {
				phandle = <0x23>;

				pins_cmd_dat {
					pinmux = <0x7f01>;
					drive-strength = <0x01>;
				};
			};

			camera_pins_cam3_mclk_6ma {
				phandle = <0x24>;

				pins_cmd_dat {
					pinmux = <0x7f01>;
					drive-strength = <0x02>;
				};
			};

			camera_pins_cam3_mclk_8ma {
				phandle = <0x25>;

				pins_cmd_dat {
					pinmux = <0x7f01>;
					drive-strength = <0x03>;
				};
			};

			camera_pins_cam2_mclk_off {
				phandle = <0x1c>;

				pins_cmd_dat {
					pinmux = <0x8100>;
					drive-strength = <0x01>;
				};
			};

			camera_pins_cam2_mclk_2ma {
				phandle = <0x1d>;

				pins_cmd_dat {
					pinmux = <0x8101>;
					drive-strength = <0x00>;
				};
			};

			camera_pins_cam2_mclk_4ma {
				phandle = <0x1e>;

				pins_cmd_dat {
					pinmux = <0x8101>;
					drive-strength = <0x01>;
				};
			};

			camera_pins_cam2_mclk_6ma {
				phandle = <0x1f>;

				pins_cmd_dat {
					pinmux = <0x8101>;
					drive-strength = <0x02>;
				};
			};

			camera_pins_cam2_mclk_8ma {
				phandle = <0x20>;

				pins_cmd_dat {
					pinmux = <0x8101>;
					drive-strength = <0x03>;
				};
			};

			cam0@vcam0 {
				phandle = <0x26>;

				pins_cmd_dat {
					pinmux = <0x500>;
					slew-rate = <0x01>;
					output-low;
				};
			};

			cam0@vcam1 {
				phandle = <0x27>;

				pins_cmd_dat {
					pinmux = <0x500>;
					slew-rate = <0x01>;
					output-high;
				};
			};

			cam0@vcam2 {
				phandle = <0x28>;

				pins_cmd_dat {
					pinmux = <0x6f00>;
					slew-rate = <0x01>;
					output-low;
				};
			};

			cam0@vcam3 {
				phandle = <0x29>;

				pins_cmd_dat {
					pinmux = <0x6f00>;
					slew-rate = <0x01>;
					output-high;
				};
			};

			cam0@vcam4 {
				phandle = <0x65>;

				pins_cmd_dat {
					pinmux = <0x6f00>;
					slew-rate = <0x01>;
					output-low;
				};
			};

			cam0@vcam5 {
				phandle = <0x66>;

				pins_cmd_dat {
					pinmux = <0x6f00>;
					slew-rate = <0x01>;
					output-high;
				};
			};

			cam0@vcam6 {
				phandle = <0x2a>;

				pins_cmd_dat {
					pinmux = <0x9a00>;
					slew-rate = <0x01>;
					output-low;
				};
			};

			cam0@vcam7 {
				phandle = <0x2b>;

				pins_cmd_dat {
					pinmux = <0x9a00>;
					slew-rate = <0x01>;
					output-high;
				};
			};

			cam1@vcam0 {
				phandle = <0x2c>;

				pins_cmd_dat {
					pinmux = <0x500>;
					slew-rate = <0x01>;
					output-low;
				};
			};

			cam1@vcam1 {
				phandle = <0x2d>;

				pins_cmd_dat {
					pinmux = <0x500>;
					slew-rate = <0x01>;
					output-high;
				};
			};

			cam1@vcam2 {
				phandle = <0x2e>;

				pins_cmd_dat {
					pinmux = <0x6500>;
					slew-rate = <0x01>;
					output-low;
				};
			};

			cam1@vcam3 {
				phandle = <0x2f>;

				pins_cmd_dat {
					pinmux = <0x6500>;
					slew-rate = <0x01>;
					output-high;
				};
			};

			cam1@vcam4 {
				phandle = <0x32>;

				pins_cmd_dat {
					pinmux = <0x6f00>;
					slew-rate = <0x01>;
					output-low;
				};
			};

			cam1@vcam5 {
				phandle = <0x33>;

				pins_cmd_dat {
					pinmux = <0x6f00>;
					slew-rate = <0x01>;
					output-high;
				};
			};

			cam1@vcam6 {
				phandle = <0x30>;

				pins_cmd_dat {
					pinmux = <0x9600>;
					slew-rate = <0x01>;
					output-low;
				};
			};

			cam1@vcam7 {
				phandle = <0x31>;

				pins_cmd_dat {
					pinmux = <0x9600>;
					slew-rate = <0x01>;
					output-high;
				};
			};

			cam3@vcam0 {
				phandle = <0x3a>;

				pins_cmd_dat {
					pinmux = <0x500>;
					slew-rate = <0x01>;
					output-low;
				};
			};

			cam3@vcam1 {
				phandle = <0x3b>;

				pins_cmd_dat {
					pinmux = <0x500>;
					slew-rate = <0x01>;
					output-high;
				};
			};

			cam3@vcam2 {
				phandle = <0x3c>;

				pins_cmd_dat {
					pinmux = <0x6e00>;
					slew-rate = <0x01>;
					output-low;
				};
			};

			cam3@vcam3 {
				phandle = <0x3d>;

				pins_cmd_dat {
					pinmux = <0x6e00>;
					slew-rate = <0x01>;
					output-high;
				};
			};

			cam3@vcam4 {
				phandle = <0x3e>;

				pins_cmd_dat {
					pinmux = <0x9600>;
					slew-rate = <0x01>;
					output-low;
				};
			};

			cam3@vcam5 {
				phandle = <0x3f>;

				pins_cmd_dat {
					pinmux = <0x9600>;
					slew-rate = <0x01>;
					output-high;
				};
			};

			cam2@vcam0 {
				phandle = <0x34>;

				pins_cmd_dat {
					pinmux = <0x500>;
					slew-rate = <0x01>;
					output-low;
				};
			};

			cam2@vcam1 {
				phandle = <0x35>;

				pins_cmd_dat {
					pinmux = <0x500>;
					slew-rate = <0x01>;
					output-high;
				};
			};

			cam2@vcam2 {
				phandle = <0x36>;

				pins_cmd_dat {
					pinmux = <0x6d00>;
					slew-rate = <0x01>;
					output-low;
				};
			};

			cam2@vcam3 {
				phandle = <0x37>;

				pins_cmd_dat {
					pinmux = <0x6d00>;
					slew-rate = <0x01>;
					output-high;
				};
			};

			cam2@vcam4 {
				phandle = <0x38>;

				pins_cmd_dat {
					pinmux = <0x9600>;
					slew-rate = <0x01>;
					output-low;
				};
			};

			cam2@vcam5 {
				phandle = <0x39>;

				pins_cmd_dat {
					pinmux = <0x9600>;
					slew-rate = <0x01>;
					output-high;
				};
			};

			camdefault {
				phandle = <0x01>;
			};
		};
	};

	fragment@1 {
		target = <0xffffffff>;

		__overlay__ {
			pinctrl-names = "default\0cam0_rst0\0cam0_rst1\0cam0_pnd0\0cam0_pnd1\0cam1_rst0\0cam1_rst1\0cam1_pnd0\0cam1_pnd1\0cam2_rst0\0cam2_rst1\0cam2_pnd0\0cam2_pnd1\0cam3_rst0\0cam3_rst1\0cam3_pnd0\0cam3_pnd1\0cam0_mclk_off\0cam0_mclk_2mA\0cam0_mclk_4mA\0cam0_mclk_6mA\0cam0_mclk_8mA\0cam1_mclk_off\0cam1_mclk_2mA\0cam1_mclk_4mA\0cam1_mclk_6mA\0cam1_mclk_8mA\0cam2_mclk_off\0cam2_mclk_2mA\0cam2_mclk_4mA\0cam2_mclk_6mA\0cam2_mclk_8mA\0cam3_mclk_off\0cam3_mclk_2mA\0cam3_mclk_4mA\0cam3_mclk_6mA\0cam3_mclk_8mA\0cam0_ldo_vcamio_0\0cam0_ldo_vcamio_1\0cam0_ldo_vcamd_0\0cam0_ldo_vcamd_1\0cam0_ldo_vcama_0\0cam0_ldo_vcama_1\0cam1_ldo_vcamio_0\0cam1_ldo_vcamio_1\0cam1_ldo_vcamd_0\0cam1_ldo_vcamd_1\0cam1_ldo_vcama_0\0cam1_ldo_vcama_1\0cam1_ldo_vcama1_0\0cam1_ldo_vcama1_1\0cam2_ldo_vcamio_0\0cam2_ldo_vcamio_1\0cam2_ldo_vcamd_0\0cam2_ldo_vcamd_1\0cam2_ldo_vcama_0\0cam2_ldo_vcama_1\0cam3_ldo_vcamio_0\0cam3_ldo_vcamio_1\0cam3_ldo_vcamd_0\0cam3_ldo_vcamd_1\0cam3_ldo_vcama_0\0cam3_ldo_vcama_1";
			pinctrl-0 = <0x01>;
			pinctrl-1 = <0x02>;
			pinctrl-2 = <0x03>;
			pinctrl-3 = <0x04>;
			pinctrl-4 = <0x05>;
			pinctrl-5 = <0x06>;
			pinctrl-6 = <0x07>;
			pinctrl-7 = <0x08>;
			pinctrl-8 = <0x09>;
			pinctrl-9 = <0x0a>;
			pinctrl-10 = <0x0b>;
			pinctrl-11 = <0x0c>;
			pinctrl-12 = <0x0d>;
			pinctrl-13 = <0x0e>;
			pinctrl-14 = <0x0f>;
			pinctrl-15 = <0x10>;
			pinctrl-16 = <0x11>;
			pinctrl-17 = <0x12>;
			pinctrl-18 = <0x13>;
			pinctrl-19 = <0x14>;
			pinctrl-20 = <0x15>;
			pinctrl-21 = <0x16>;
			pinctrl-22 = <0x17>;
			pinctrl-23 = <0x18>;
			pinctrl-24 = <0x19>;
			pinctrl-25 = <0x1a>;
			pinctrl-26 = <0x1b>;
			pinctrl-27 = <0x1c>;
			pinctrl-28 = <0x1d>;
			pinctrl-29 = <0x1e>;
			pinctrl-30 = <0x1f>;
			pinctrl-31 = <0x20>;
			pinctrl-32 = <0x21>;
			pinctrl-33 = <0x22>;
			pinctrl-34 = <0x23>;
			pinctrl-35 = <0x24>;
			pinctrl-36 = <0x25>;
			pinctrl-37 = <0x26>;
			pinctrl-38 = <0x27>;
			pinctrl-39 = <0x28>;
			pinctrl-40 = <0x29>;
			pinctrl-41 = <0x2a>;
			pinctrl-42 = <0x2b>;
			pinctrl-43 = <0x2c>;
			pinctrl-44 = <0x2d>;
			pinctrl-45 = <0x2e>;
			pinctrl-46 = <0x2f>;
			pinctrl-47 = <0x30>;
			pinctrl-48 = <0x31>;
			pinctrl-49 = <0x32>;
			pinctrl-50 = <0x33>;
			pinctrl-51 = <0x34>;
			pinctrl-52 = <0x35>;
			pinctrl-53 = <0x36>;
			pinctrl-54 = <0x37>;
			pinctrl-55 = <0x38>;
			pinctrl-56 = <0x39>;
			pinctrl-57 = <0x3a>;
			pinctrl-58 = <0x3b>;
			pinctrl-59 = <0x3c>;
			pinctrl-60 = <0x3d>;
			pinctrl-61 = <0x3e>;
			pinctrl-62 = <0x3f>;
			cam0_pin_mclk = "mclk";
			cam0_pin_rst = "gpio";
			cam0_pin_pdn = "gpio";
			cam0_pin_vcama = "gpio";
			cam0_pin_vcamio = "gpio";
			cam0_pin_vcamd = "gpio";
			cam0_pin_vcamaf = "gpio";
			cam1_pin_mclk = "mclk";
			cam1_pin_rst = "gpio";
			cam1_pin_pdn = "gpio";
			cam1_pin_vcama = "gpio";
			cam1_pin_vcama1 = "gpio";
			cam1_pin_vcamio = "gpio";
			cam1_pin_vcamd = "gpio";
			cam2_pin_mclk = "mclk";
			cam2_pin_rst = "gpio";
			cam2_pin_pdn = "gpio";
			cam2_pin_vcama = "gpio";
			cam2_pin_vcamio = "gpio";
			cam2_pin_vcamd = "gpio";
			cam3_pin_mclk = "mclk";
			cam3_pin_rst = "gpio";
			cam3_pin_pdn = "gpio";
			cam3_pin_vcama = "gpio";
			cam3_pin_vcamio = "gpio";
			cam3_pin_vcamd = "gpio";
			cam0_enable_sensor = "s5kgw3sp_mipi_raw s5kjn1_mipi_raw";
			cam1_enable_sensor = "ov16a1q_mipi_raw s5k3l6_mipi_raw";
			cam2_enable_sensor = "bf2257_mipi_raw";
			cam3_enable_sensor = "bf20a1_mipi_raw";
			status = "okay";
		};
	};

	fragment@2 {
		target = <0xffffffff>;

		__overlay__ {
			status = "okay";
			clock-frequency = <0x61a80>;
			#address-cells = <0x01>;
			#size-cells = <0x00>;

			camera_eeprom3@50 {
				compatible = "mediatek,camera_eeprom";
				reg = <0x50>;
				status = "disabled";
				phandle = <0x67>;
			};

			camera_sub_two@31 {
				compatible = "mediatek,camera_sub_two";
				#thermal-sensor-cells = <0x00>;
				reg = <0x31>;
				status = "okay";
				phandle = <0x43>;
			};
		};
	};

	fragment@3 {
		target = <0xffffffff>;

		__overlay__ {
			status = "okay";
			clock-frequency = <0x61a80>;
			#address-cells = <0x01>;
			#size-cells = <0x00>;

			camera_eeprom2@51 {
				compatible = "mediatek,camera_eeprom";
				reg = <0x51>;
				status = "disabled";
				phandle = <0x68>;
			};

			camera_main_two@37 {
				compatible = "mediatek,camera_main_two";
				#thermal-sensor-cells = <0x00>;
				reg = <0x37>;
				status = "okay";
				phandle = <0x42>;
			};
		};
	};

	fragment@4 {
		target = <0xffffffff>;

		__overlay__ {
			status = "okay";
			clock-frequency = <0x61a80>;
			#address-cells = <0x01>;
			#size-cells = <0x00>;

			camera_eeprom1@52 {
				compatible = "mediatek,camera_eeprom";
				reg = <0x52>;
				status = "okay";
				phandle = <0x69>;
			};

			camera_sub@20 {
				compatible = "mediatek,camera_sub";
				#thermal-sensor-cells = <0x00>;
				reg = <0x20>;
				status = "okay";
				phandle = <0x41>;
			};
		};
	};

	fragment@5 {
		target = <0xffffffff>;

		__overlay__ {
			status = "okay";
			clock-frequency = <0x61a80>;
			#address-cells = <0x01>;
			#size-cells = <0x00>;

			camera_eeprom0@50 {
				compatible = "mediatek,camera_eeprom";
				reg = <0x50>;
				status = "okay";
				phandle = <0x6a>;
			};

			camera_main@20 {
				compatible = "mediatek,camera_main";
				#thermal-sensor-cells = <0x00>;
				reg = <0x20>;
				status = "okay";
				phandle = <0x40>;
			};
		};
	};

	fragment@6 {
		target = <0xffffffff>;

		__overlay__ {

			camera_main {
				polling-delay = <0x3e8>;
				polling-delay-passive = <0x00>;
				thermal-sensors = <0x40>;
				phandle = <0x6b>;
			};

			camera_sub {
				polling-delay = <0x3e8>;
				polling-delay-passive = <0x00>;
				thermal-sensors = <0x41>;
				phandle = <0x6c>;
			};

			camera_main_two {
				polling-delay = <0x3e8>;
				polling-delay-passive = <0x00>;
				thermal-sensors = <0x42>;
				phandle = <0x6d>;
			};

			camera_sub_two {
				polling-delay = <0x3e8>;
				polling-delay-passive = <0x00>;
				thermal-sensors = <0x43>;
				phandle = <0x6e>;
			};
		};
	};

	fragment@7 {
		target = <0xffffffff>;

		__overlay__ {
			#address-cells = <0x01>;
			#size-cells = <0x00>;
			status = "okay";

			chipone@0 {
				compatible = "mediatek,chipone_fp";
				reg = <0x00>;
				spi-max-frequency = <0x7a1200>;
				vdd_fps-supply = <0xffffffff>;
				status = "okay";
			};
		};
	};

	fragment@8 {
		target = <0xffffffff>;

		__overlay__ {

			spi_default {
				phandle = <0x44>;
			};

			fpsensor_cs_set@gpio31 {
				phandle = <0x45>;

				pins_cmd_dat {
					pinmux = <0x1f01>;
					slew-rate = <0x01>;
				};
			};

			fpsensor_cs_gpio_high@gpio31 {
				phandle = <0x46>;

				pins_cmd_dat {
					pinmux = <0x1f00>;
					slew-rate = <0x01>;
					output-high;
				};
			};

			fpsensor_cs_gpio_low@gpio31 {
				phandle = <0x47>;

				pins_cmd_dat {
					pinmux = <0x1f00>;
					slew-rate = <0x01>;
					output-low;
				};
			};

			fpsensor_mi_set@gpio33 {
				phandle = <0x48>;

				pins_cmd_dat {
					pinmux = <0x2101>;
					slew-rate = <0x00>;
				};
			};

			fpsensor_mo_set@gpio32 {
				phandle = <0x49>;

				pins_cmd_dat {
					pinmux = <0x2001>;
					slew-rate = <0x01>;
				};
			};

			fpsensor_clk_set@gpio30 {
				phandle = <0x4a>;

				pins_cmd_dat {
					pinmux = <0x1e01>;
					slew-rate = <0x01>;
				};
			};

			fpsensor_rst_high@gpio102 {
				phandle = <0x4b>;

				pins_cmd_dat {
					pinmux = <0x6600>;
					slew-rate = <0x01>;
					output-high;
				};
			};

			fpsensor_rst_low@gpio10 {
				phandle = <0x4c>;

				pins_cmd_dat {
					pinmux = <0x6600>;
					slew-rate = <0x01>;
					output-low;
				};
			};

			fpsensor_eint@gpio8 {
				phandle = <0x4d>;

				pins_cmd_dat {
					pinmux = <0x800>;
					slew-rate = <0x00>;
					bias-disable;
				};
			};
		};
	};

	fragment@9 {
		target = <0xffffffff>;

		__overlay__ {
			pinctrl-names = "spi_default\0fpsensor_cs_set\0fpsensor_cs_gpio_high\0fpsensor_cs_gpio_low\0fpsensor_mi_set\0fpsensor_mo_set\0fpsensor_clk_set\0fpsensor_rst_high\0fpsensor_rst_low\0fpsensor_eint";
			pinctrl-0 = <0x44>;
			pinctrl-1 = <0x45>;
			pinctrl-2 = <0x46>;
			pinctrl-3 = <0x47>;
			pinctrl-4 = <0x48>;
			pinctrl-5 = <0x49>;
			pinctrl-6 = <0x4a>;
			pinctrl-7 = <0x4b>;
			pinctrl-8 = <0x4c>;
			pinctrl-9 = <0x4d>;
			interrupt-parent = <0xffffffff>;
			interrupts = <0x08 0x01 0x08 0x00>;
			status = "okay";
		};
	};

	fragment@10 {
		target = <0xffffffff>;

		__overlay__ {
			clock-frequency = <0x61a80>;
			status = "okay";

			sc2150-pd@4e {
				compatible = "southchip,sc2150";
				reg = <0x4e>;
				status = "okay";
				sc-tcpc,name = "type_c_port0";
				sc-tcpc,role_def = <0x05>;
				sc-tcpc,rp_level = <0x00>;
				sc-tcpc,vconn_supply = <0x01>;
				sc-tcpc,notifier_supply_num = <0x02>;
				sc2150,intr-gpio = <0xffffffff 0x06 0x02>;

				pd-data {
					pd,vid = <0x311c>;
					pd,pid = <0x2150>;
					pd,source-cap-ext = [1c 31 00 66 00 00 00 00 00 00 00 00 00 00 00 00 00 00 00 00 00 00 01 06 00];
					pd,sink-cap-ext = <0x1c310066 0x00 0x1000000 0x00 0x1000000 0x00>;
					pd,mfrs = "SouthChip";
					pd,charging_policy = <0x31>;
					pd,source-pdo-size = <0x01>;
					pd,source-pdo-data = <0x36019078>;
					pd,sink-pdo-size = <0x02>;
					pd,sink-pdo-data = <0x360190c8 0xc0dc213c>;
					pd,id-vdo-size = <0x06>;
					pd,id-vdo-data = <0xd14029cf 0x00 0x17110000 0x61000000 0x00 0x41000000>;
					bat,nr = <0x01>;
					pd,country_nr = <0x00>;

					bat-info0 {
						bat,vid = <0x311c>;
						bat,pid = <0x2150>;
						bat,mfrs = "bat1";
						bat,design_cap = <0xbb8>;
					};
				};

				dpm_caps {
					local_dr_power;
					local_dr_data;
					local_no_suspend;
					local_vconn_supply;
					attempt_discover_cable;
					attempt_discover_id;
					attempt_discover_svid;
					pr_check = <0x00>;
					dr_check = <0x00>;
				};

				displayport {
					1st_connection = "dfp_d";
					2nd_connection = "dfp_d";
					signal,dp_v13;
					typec,receptacle;

					ufp_d {
					};

					dfp_d {
						pin_assignment,mode_c;
						pin_assignment,mode_d;
						pin_assignment,mode_e;
					};
				};
			};
		};
	};

	fragment@11 {
		target = <0xffffffff>;

		__overlay__ {
			compatible = "mediatek,pwm-leds";

			backlight {
				led_mode = <0x05>;
				pwms = <0xffffffff 0x00 0x99d9>;
				pwm-names = "lcd-backlight";
				pwm_config = <0x00 0x01 0x00 0x00 0x00>;
			};
		};
	};

	fragment@12 {
		target = <0xffffffff>;

		__overlay__ {

			lcd_bias_enp1_gpio {
				phandle = <0x4e>;

				pins_cmd_dat {
					pinmux = <0x9900>;
					slew-rate = <0x01>;
					output-high;
				};
			};

			lcd_bias_enp0_gpio {
				phandle = <0x4f>;

				pins_cmd_dat {
					pinmux = <0x9900>;
					slew-rate = <0x01>;
					output-low;
				};
			};

			lcd_bias_enn1_gpio {
				phandle = <0x50>;

				pins_cmd_dat {
					pinmux = <0x9f00>;
					slew-rate = <0x01>;
					output-high;
				};
			};

			lcd_bias_enn0_gpio {
				phandle = <0x51>;

				pins_cmd_dat {
					pinmux = <0x9f00>;
					slew-rate = <0x01>;
					output-low;
				};
			};

			lcm_rst_out1_gpio {
				phandle = <0x52>;

				pins_cmd_dat {
					pinmux = <0x5500>;
					slew-rate = <0x01>;
					output-high;
				};
			};

			lcm_rst_out0_gpio {
				phandle = <0x53>;

				pins_cmd_dat {
					pinmux = <0x5500>;
					slew-rate = <0x01>;
					output-low;
				};
			};

			lcm_dsi_te {
				phandle = <0x54>;

				pins_cmd_dat {
					pinmux = <0x5301>;
				};
			};
		};
	};

	fragment@13 {
		target = <0xffffffff>;

		__overlay__ {
			pinctrl-names = "lcd_bias_enp1_gpio\0lcd_bias_enp0_gpio\0lcd_bias_enn1_gpio\0lcd_bias_enn0_gpio\0lcm_rst_out1_gpio\0lcm_rst_out0_gpio\0mode_te_te";
			pinctrl-0 = <0x4e>;
			pinctrl-1 = <0x4f>;
			pinctrl-2 = <0x50>;
			pinctrl-3 = <0x51>;
			pinctrl-4 = <0x52>;
			pinctrl-5 = <0x53>;
			pinctrl-6 = <0x54>;
			status = "okay";
		};
	};

	fragment@14 {
		target = <0xffffffff>;

		__overlay__ {
			pinctrl-names = "lcm_rst_out1_gpio\0lcm_rst_out0_gpio\0mode_te_te";
			pinctrl-0 = <0x52>;
			pinctrl-1 = <0x53>;
			pinctrl-2 = <0x54>;
			status = "okay";
		};
	};

	fragment@15 {
		target = <0xffffffff>;

		__overlay__ {
			status = "okay";
			#address-cells = <0x01>;
			#size-cells = <0x00>;

			panel1@0 {
				compatible = "ft8725,vdo-m9903";
				reg = <0x00>;
				reset-gpios = <0xffffffff 0x55 0x00>;
				bias-gpios = <0xffffffff 0x99 0x00 0xffffffff 0x9f 0x00>;
				pinctrl-names = "default";

				port {

					endpoint {
						remote-endpoint = <0x55>;
						phandle = <0x56>;
					};
				};
			};

			ports {

				port {

					endpoint {
						remote-endpoint = <0x56>;
						phandle = <0x55>;
					};
				};
			};
		};
	};

	fragment@16 {
		target = <0xffffffff>;

		__overlay__ {

			gps_default {
				phandle = <0x57>;
			};

			gps_l1_lna@0 {
				phandle = <0x58>;

				pins_cmd_dat {
					pinmux = <0x1900>;
					output-low;
				};
			};

			gps_l1_lna@1 {
				phandle = <0x59>;

				pins_cmd_dat {
					pinmux = <0x1902>;
				};
			};

			gps_l1_lna@2 {
				phandle = <0x5a>;

				pins_cmd_dat {
					pinmux = <0x1900>;
					output-high;
				};
			};

			gps_l5_lna@0 {
				phandle = <0x5b>;

				pins_cmd_dat {
					pinmux = <0x1a00>;
					output-low;
				};
			};

			gps_l5_lna@1 {
				phandle = <0x5c>;

				pins_cmd_dat {
					pinmux = <0x1a02>;
				};
			};

			gps_l5_lna@2 {
				phandle = <0x5d>;

				pins_cmd_dat {
					pinmux = <0x1a00>;
					output-high;
				};
			};
		};
	};

	fragment@17 {
		target = <0xffffffff>;

		__overlay__ {
			pinctrl-names = "default\0gps_l1_lna_disable\0gps_l1_lna_dsp_ctrl\0gps_l1_lna_enable\0gps_l5_lna_disable\0gps_l5_lna_dsp_ctrl\0gps_l5_lna_enable";
			pinctrl-0 = <0x57>;
			pinctrl-1 = <0x58>;
			pinctrl-2 = <0x59>;
			pinctrl-3 = <0x5a>;
			pinctrl-4 = <0x5b>;
			pinctrl-5 = <0x5c>;
			pinctrl-6 = <0x5d>;
			status = "okay";
		};
	};

	fragment@18 {
		target = <0xffffffff>;

		__overlay__ {

			focaltech@0 {
				compatible = "focaltech,fts";
				reg = <0x00>;
				spi-max-frequency = <0x5b8d80>;
				interrupt-parent = <0xffffffff>;
				interrupts = <0x09 0x02 0x09 0x00>;
				focaltech,reset-gpio = <0xffffffff 0x98 0x00>;
				focaltech,irq-gpio = <0xffffffff 0x09 0x02>;
				focaltech,max-touch-number = <0x0a>;
				focaltech,display-coords = <0x00 0x00 0x438 0x99c>;
				status = "okay";
			};
		};
	};

	fragment@19 {
		target = <0xffffffff>;

		__overlay__ {

			lm3643@63 {
				compatible = "mediatek,lm3643";
				reg = <0x63>;
				#cooling-cells = <0x02>;
				status = "disabled";
				phandle = <0x6f>;

				flash@0 {
					reg = <0x00>;
					type = <0x00>;
					ct = <0x00>;
					part = <0x00>;

					port@0 {

						endpoint {
							remote-endpoint = <0x5e>;
							phandle = <0x60>;
						};
					};
				};

				flash@1 {
					reg = <0x01>;
					type = <0x00>;
					ct = <0x01>;
					part = <0x00>;

					port@1 {

						endpoint {
							remote-endpoint = <0x5f>;
							phandle = <0x61>;
						};
					};
				};
			};
		};
	};

	fragment@20 {
		target = <0xffffffff>;

		__overlay__ {

			camaf_main@0 {
				phandle = <0x62>;

				pins_cmd_dat {
					pinmux = <0x9e00>;
					slew-rate = <0x01>;
					output-high;
				};
			};

			camaf_main@1 {
				phandle = <0x63>;

				pins_cmd_dat {
					pinmux = <0x9e00>;
					slew-rate = <0x01>;
					output-low;
				};
			};
		};
	};

	fragment@21 {
		target = <0xffffffff>;

		__overlay__ {

			port@0 {

				endpoint {
					remote-endpoint = <0x60>;
					phandle = <0x5e>;
				};
			};

			port@1 {

				endpoint {
					remote-endpoint = <0x61>;
					phandle = <0x5f>;
				};
			};
		};
	};

	fragment@22 {
		target = <0xffffffff>;

		__overlay__ {

			camera_main_af@0c {
				compatible = "mediatek,camera_main_af";
				reg = <0x0c>;
				status = "okay";
				phandle = <0x70>;
			};
		};
	};

	fragment@23 {
		target = <0xffffffff>;

		__overlay__ {

			camera_main_two_af@0d {
				compatible = "mediatek,camera_main_two_af";
				reg = <0x0d>;
				status = "disabled";
				phandle = <0x71>;
			};

			camera_main_three_af@72 {
				compatible = "mediatek,camera_main_three_af";
				reg = <0x72>;
				status = "disabled";
				phandle = <0x72>;
			};
		};
	};

	fragment@24 {
		target = <0xffffffff>;

		__overlay__ {
			pinctrl-names = "camaf_m1_gpio_on\0camaf_m1_gpio_off";
			pinctrl-0 = <0x62>;
			pinctrl-1 = <0x63>;
			status = "okay";
		};
	};

	fragment@25 {
		target = <0xffffffff>;

		__overlay__ {

			aw2033@45 {
				compatible = "awinic,aw2033_led";
				status = "disabled";
				reg = <0x45>;

				aw2033,red {
					aw2033,name = "red";
					aw2033,id = <0x00>;
					aw2033,imax = <0x02>;
					aw2033,led-current = <0x03>;
					aw2033,max-brightness = <0xff>;
					aw2033,rise-time-ms = <0x06>;
					aw2033,hold-time-ms = <0x00>;
					aw2033,fall-time-ms = <0x06>;
					aw2033,off-time-ms = <0x04>;
				};

				aw2033,green {
					aw2033,name = "green";
					aw2033,id = <0x01>;
					aw2033,imax = <0x02>;
					aw2033,led-current = <0x03>;
					aw2033,max-brightness = <0xff>;
					aw2033,rise-time-ms = <0x06>;
					aw2033,hold-time-ms = <0x00>;
					aw2033,fall-time-ms = <0x06>;
					aw2033,off-time-ms = <0x04>;
				};

				aw2033,blue {
					aw2033,name = "blue";
					aw2033,id = <0x02>;
					aw2033,imax = <0x02>;
					aw2033,led-current = <0x03>;
					aw2033,max-brightness = <0xff>;
					aw2033,rise-time-ms = <0x06>;
					aw2033,hold-time-ms = <0x00>;
					aw2033,fall-time-ms = <0x06>;
					aw2033,off-time-ms = <0x04>;
				};
			};
		};
	};

	fragment@26 {
		target = <0xffffffff>;

		__overlay__ {

			aw2033_back@45 {
				compatible = "awinic,aw2033_back_led";
				reg = <0x45>;

				aw2033_back,red {
					aw2033_back,name = "red";
					aw2033_back,id = <0x00>;
					aw2033_back,imax = <0x01>;
					aw2033_back,led-current = <0x03>;
					aw2033_back,max-brightness = <0xff>;
					aw2033_back,rise-time-ms = <0x06>;
					aw2033_back,hold-time-ms = <0x00>;
					aw2033_back,fall-time-ms = <0x06>;
					aw2033_back,off-time-ms = <0x04>;
				};

				aw2033_back,green {
					aw2033_back,name = "green";
					aw2033_back,id = <0x01>;
					aw2033_back,imax = <0x01>;
					aw2033_back,led-current = <0x03>;
					aw2033_back,max-brightness = <0xff>;
					aw2033_back,rise-time-ms = <0x06>;
					aw2033_back,hold-time-ms = <0x00>;
					aw2033_back,fall-time-ms = <0x06>;
					aw2033_back,off-time-ms = <0x04>;
				};

				aw2033_back,blue {
					aw2033_back,name = "blue";
					aw2033_back,id = <0x02>;
					aw2033_back,imax = <0x01>;
					aw2033_back,led-current = <0x03>;
					aw2033_back,max-brightness = <0xff>;
					aw2033_back,rise-time-ms = <0x06>;
					aw2033_back,hold-time-ms = <0x00>;
					aw2033_back,fall-time-ms = <0x06>;
					aw2033_back,off-time-ms = <0x04>;
				};
			};
		};
	};

	fragment@27 {
		target = <0xffffffff>;

		__overlay__ {

			aw87xxx_pa@5C {
				compatible = "awinic,aw87xxx_pa";
				reg = <0x58>;
				reset-gpio = <0xffffffff 0x43 0x00>;
				dev_index = <0x00>;
				status = "okay";
				phandle = <0x64>;
			};

			i2c_lcd_bias@3e {
				compatible = "mediatek,i2c_lcd_bias";
				reg = <0x3e>;
				id = <0x06>;
				status = "okay";
				phandle = <0x73>;
			};
		};
	};

	fragment@28 {
		target = <0xffffffff>;

		__overlay__ {
			#address-cells = <0x01>;
			#size-cells = <0x00>;
			clock-frequency = <0x61a80>;
			status = "okay";

			sec-nfc@27 {
				compatible = "sec-nfc";
				reg = <0x27>;
				sec-nfc,ven-gpio = <0xffffffff 0x67 0x00>;
				sec-nfc,firm-gpio = <0xffffffff 0x68 0x00>;
				sec-nfc,irq-gpio = <0xffffffff 0x01 0x00>;
				sec-nfc,clk_req-gpio = <0xffffffff 0x44 0x00>;
				sec-nfc,pmic-ldo = "vdd_ldo20";
			};
		};
	};

	fragment@29 {
		target = <0xffffffff>;

		__overlay__ {
			status = "okay";

			sc8551-charger@66 {
				compatible = "sc,sc8551-standalone";
				reg = <0x66>;
				sc,sc8551,irq-gpio = <0xffffffff 0x0c 0x00>;
				sc,sc8551,bat-ovp-threshold = <0x1194>;
				sc,sc8551,bat-ocp-threshold = <0x1770>;
				sc,sc8551,bus-ovp-threshold = <0x2ee0>;
				sc,sc8551,bus-ocp-threshold = <0xea6>;
				sc,sc8551,ac-ovp-threshold = <0x2ee0>;
				sc,sc8551,sense-resistor-mohm = <0x05>;
			};
		};
	};

	fragment@30 {
		target = <0xffffffff>;

		__overlay__ {
			mediatek,spk-i2s = <0x03 0x00>;

			mediatek,speaker-codec {
				sound-dai = <0x64>;
			};
		};
	};

	fragment@31 {
		target = <0xffffffff>;

		__overlay__ {
			pd_vbus_upper_bound = <0xb71b00>;
		};
	};

	fragment@32 {
		target = <0xffffffff>;

		__overlay__ {
			flash-en-gpio = <0xffffffff 0x9d 0x00>;
			flash-sel-gpio = <0xffffffff 0x9b 0x00>;
		};
	};

	fragment@33 {
		target = <0xffffffff>;

		__overlay__ {
			GPIO_SIM1_HOT_PLUG = <0xffffffff 0x17 0x00>;
			GPIO_SIM2_HOT_PLUG = <0xffffffff 0x18 0x00>;
			GPIO_SIM1_SCLK = <0xffffffff 0x4d 0x00>;
			GPIO_SIM1_SRST = <0xffffffff 0x4e 0x00>;
			GPIO_SIM1_SIO = <0xffffffff 0x4f 0x00>;
			GPIO_SIM2_SCLK = <0xffffffff 0x50 0x00>;
			GPIO_SIM2_SRST = <0xffffffff 0x51 0x00>;
			GPIO_SIM2_SIO = <0xffffffff 0x52 0x00>;
		};
	};

	fragment@34 {
		target = <0xffffffff>;

		__overlay__ {
			gpio_init_default = <0x00 0x00 0x00 0x00 0x01 0x01 0x01 0x01 0x00 0x00 0x00 0x01 0x00 0x01 0x02 0x00 0x00 0x00 0x01 0x00 0x01 0x03 0x00 0x00 0x00 0x01 0x00 0x01 0x04 0x00 0x00 0x00 0x01 0x01 0x01 0x05 0x00 0x01 0x00 0x01 0x00 0x01 0x06 0x00 0x00 0x00 0x01 0x01 0x01 0x07 0x00 0x00 0x00 0x01 0x01 0x01 0x08 0x00 0x00 0x00 0x01 0x01 0x01 0x09 0x00 0x00 0x00 0x01 0x01 0x01 0x0a 0x00 0x00 0x00 0x01 0x00 0x01 0x0b 0x00 0x00 0x00 0x01 0x01 0x01 0x0c 0x00 0x01 0x00 0x01 0x00 0x01 0x0d 0x06 0x00 0x00 0x01 0x00 0x01 0x0e 0x06 0x00 0x00 0x01 0x00 0x00 0x0f 0x00 0x01 0x00 0x01 0x00 0x00 0x10 0x00 0x01 0x00 0x01 0x00 0x00 0x11 0x00 0x01 0x00 0x01 0x00 0x00 0x12 0x00 0x01 0x00 0x01 0x00 0x00 0x13 0x00 0x01 0x00 0x01 0x00 0x00 0x14 0x00 0x01 0x00 0x01 0x00 0x00 0x15 0x00 0x01 0x00 0x01 0x00 0x00 0x16 0x00 0x01 0x00 0x01 0x00 0x00 0x17 0x01 0x00 0x00 0x01 0x01 0x00 0x18 0x01 0x00 0x00 0x01 0x01 0x00 0x19 0x02 0x00 0x00 0x01 0x00 0x01 0x1a 0x02 0x00 0x00 0x01 0x00 0x01 0x1b 0x01 0x00 0x00 0x01 0x00 0x01 0x1c 0x01 0x00 0x00 0x01 0x01 0x01 0x1d 0x01 0x00 0x00 0x00 0x00 0x01 0x1e 0x01 0x00 0x00 0x00 0x00 0x01 0x1f 0x01 0x00 0x00 0x00 0x00 0x01 0x20 0x01 0x00 0x00 0x00 0x00 0x01 0x21 0x01 0x00 0x00 0x01 0x00 0x01 0x22 0x06 0x00 0x00 0x01 0x00 0x00 0x23 0x06 0x00 0x00 0x01 0x00 0x00 0x24 0x06 0x00 0x00 0x00 0x00 0x00 0x25 0x06 0x00 0x00 0x01 0x00 0x00 0x26 0x02 0x00 0x00 0x00 0x00 0x01 0x27 0x02 0x00 0x00 0x00 0x00 0x01 0x28 0x02 0x00 0x00 0x00 0x00 0x01 0x29 0x02 0x00 0x00 0x01 0x00 0x01 0x2a 0x01 0x00 0x00 0x00 0x00 0x00 0x2b 0x01 0x00 0x00 0x00 0x00 0x00 0x2c 0x01 0x00 0x00 0x00 0x00 0x00 0x2d 0x01 0x00 0x00 0x01 0x00 0x00 0x2e 0x06 0x00 0x00 0x01 0x00 0x00 0x2f 0x06 0x00 0x00 0x01 0x00 0x00 0x30 0x06 0x00 0x00 0x00 0x00 0x00 0x31 0x06 0x00 0x00 0x01 0x00 0x00 0x32 0x02 0x00 0x00 0x00 0x00 0x01 0x33 0x02 0x00 0x00 0x00 0x00 0x01 0x34 0x02 0x00 0x00 0x00 0x00 0x01 0x35 0x02 0x00 0x00 0x01 0x00 0x01 0x42 0x01 0x00 0x00 0x01 0x01 0x00 0x43 0x00 0x01 0x00 0x01 0x00 0x01 0x44 0x00 0x00 0x00 0x01 0x00 0x01 0x45 0x00 0x00 0x00 0x01 0x01 0x01 0x4d 0x01 0x00 0x00 0x00 0x00 0x01 0x4e 0x01 0x00 0x00 0x00 0x00 0x01 0x4f 0x01 0x00 0x00 0x01 0x01 0x01 0x50 0x01 0x00 0x00 0x00 0x00 0x01 0x51 0x01 0x00 0x00 0x00 0x00 0x01 0x52 0x01 0x00 0x00 0x01 0x01 0x01 0x53 0x01 0x00 0x00 0x01 0x00 0x01 0x54 0x01 0x00 0x00 0x00 0x00 0x01 0x55 0x01 0x00 0x00 0x00 0x00 0x01 0x56 0x01 0x00 0x00 0x01 0x00 0x00 0x57 0x01 0x00 0x00 0x01 0x00 0x00 0x58 0x01 0x00 0x00 0x01 0x00 0x00 0x59 0x01 0x00 0x00 0x01 0x00 0x00 0x5a 0x01 0x00 0x00 0x01 0x00 0x00 0x5b 0x01 0x00 0x00 0x01 0x00 0x00 0x5c 0x01 0x00 0x00 0x01 0x00 0x00 0x5d 0x01 0x00 0x00 0x01 0x00 0x00 0x5e 0x01 0x00 0x00 0x01 0x00 0x00 0x5f 0x01 0x00 0x00 0x01 0x00 0x00 0x60 0x01 0x00 0x00 0x01 0x00 0x00 0x61 0x01 0x00 0x00 0x01 0x00 0x00 0x62 0x01 0x00 0x00 0x01 0x00 0x00 0x63 0x01 0x00 0x00 0x01 0x00 0x00 0x64 0x00 0x00 0x00 0x01 0x00 0x00 0x65 0x00 0x01 0x00 0x01 0x00 0x00 0x66 0x00 0x01 0x01 0x01 0x00 0x00 0x67 0x00 0x01 0x00 0x01 0x00 0x00 0x68 0x00 0x00 0x00 0x01 0x00 0x00 0x69 0x01 0x00 0x00 0x01 0x00 0x00 0x6a 0x01 0x00 0x00 0x01 0x00 0x00 0x6b 0x01 0x00 0x00 0x01 0x00 0x00 0x6c 0x01 0x00 0x00 0x01 0x00 0x00 0x6d 0x00 0x01 0x00 0x01 0x00 0x00 0x6e 0x00 0x01 0x00 0x01 0x00 0x00 0x6f 0x00 0x01 0x00 0x01 0x00 0x00 0x70 0x01 0x00 0x00 0x00 0x00 0x00 0x71 0x01 0x00 0x00 0x01 0x00 0x00 0x72 0x01 0x00 0x00 0x00 0x00 0x00 0x73 0x01 0x00 0x00 0x01 0x00 0x00 0x74 0x01 0x00 0x00 0x00 0x00 0x00 0x75 0x01 0x00 0x00 0x01 0x00 0x00 0x76 0x01 0x00 0x00 0x00 0x00 0x00 0x77 0x01 0x00 0x00 0x01 0x00 0x00 0x78 0x01 0x00 0x00 0x00 0x00 0x00 0x79 0x01 0x00 0x00 0x01 0x00 0x00 0x7a 0x01 0x00 0x00 0x00 0x00 0x00 0x7b 0x01 0x00 0x00 0x00 0x00 0x00 0x7c 0x01 0x00 0x00 0x01 0x00 0x00 0x7d 0x01 0x00 0x00 0x01 0x00 0x00 0x7e 0x01 0x00 0x00 0x01 0x00 0x00 0x7f 0x01 0x00 0x00 0x01 0x00 0x00 0x80 0x01 0x00 0x00 0x01 0x00 0x00 0x81 0x01 0x00 0x00 0x01 0x00 0x00 0x82 0x01 0x00 0x00 0x01 0x01 0x01 0x83 0x01 0x00 0x00 0x01 0x01 0x01 0x84 0x02 0x00 0x00 0x01 0x01 0x00 0x85 0x02 0x00 0x00 0x01 0x01 0x00 0x86 0x01 0x00 0x00 0x01 0x01 0x01 0x87 0x01 0x00 0x00 0x01 0x01 0x01 0x88 0x01 0x00 0x00 0x01 0x01 0x01 0x89 0x01 0x00 0x00 0x01 0x01 0x01 0x8a 0x01 0x00 0x00 0x01 0x01 0x01 0x8b 0x01 0x00 0x00 0x01 0x01 0x01 0x8c 0x01 0x00 0x00 0x01 0x01 0x01 0x8d 0x01 0x00 0x00 0x01 0x01 0x01 0x8e 0x01 0x00 0x00 0x01 0x01 0x01 0x8f 0x01 0x00 0x00 0x01 0x01 0x01 0x90 0x01 0x00 0x00 0x01 0x01 0x01 0x91 0x01 0x00 0x00 0x01 0x01 0x01 0x92 0x01 0x00 0x00 0x01 0x01 0x01 0x93 0x01 0x00 0x00 0x01 0x01 0x01 0x94 0x01 0x00 0x00 0x01 0x01 0x01 0x95 0x01 0x00 0x00 0x01 0x01 0x01 0x96 0x00 0x01 0x00 0x01 0x00 0x01 0x97 0x00 0x01 0x01 0x01 0x00 0x01 0x98 0x00 0x01 0x00 0x01 0x00 0x01 0x99 0x00 0x01 0x00 0x01 0x00 0x01 0x9a 0x00 0x01 0x00 0x01 0x00 0x01 0x9b 0x00 0x01 0x00 0x01 0x00 0x01 0x9c 0x00 0x01 0x00 0x01 0x00 0x01 0x9d 0x00 0x01 0x00 0x01 0x00 0x01 0x9e 0x00 0x01 0x01 0x01 0x00 0x00 0x9f 0x00 0x01 0x00 0x01 0x00 0x00 0xa0 0x01 0x00 0x00 0x00 0x00 0x01 0xa1 0x01 0x00 0x00 0x00 0x00 0x01 0xa2 0x01 0x00 0x00 0x00 0x00 0x01 0xa3 0x01 0x00 0x00 0x01 0x00 0x01 0xa4 0x01 0x00 0x00 0x00 0x00 0x01 0xa5 0x01 0x00 0x00 0x00 0x00 0x01 0xa6 0x01 0x00 0x00 0x00 0x00 0x01 0xa7 0x01 0x00 0x00 0x01 0x00 0x01 0xa8 0x01 0x00 0x00 0x00 0x00 0x00 0xa9 0x01 0x00 0x00 0x00 0x00 0x01 0xaa 0x01 0x00 0x00 0x00 0x00 0x01 0xab 0x01 0x00 0x00 0x00 0x00 0x01 0xac 0x00 0x00 0x00 0x01 0x00 0x01 0xad 0x01 0x00 0x00 0x01 0x00 0x01 0xae 0x01 0x00 0x00 0x01 0x00 0x01 0xaf 0x01 0x00 0x00 0x01 0x00 0x01 0xb0 0x01 0x00 0x00 0x01 0x00 0x01 0xb1 0x00 0x00 0x00 0x01 0x00 0x00 0xb2 0x00 0x00 0x00 0x01 0x00 0x00 0xb3 0x00 0x00 0x00 0x01 0x00 0x00 0xb4 0x00 0x00 0x00 0x01 0x00 0x00 0xb5 0x00 0x00 0x00 0x01 0x00 0x00 0xb6 0x00 0x00 0x00 0x01 0x00 0x00 0xb7 0x00 0x00 0x00 0x01 0x00 0x00 0xb8 0x00 0x00 0x00 0x01 0x00 0x00 0xb9 0x00 0x00 0x00 0x01 0x00 0x00 0xba 0x01 0x00 0x00 0x01 0x01 0x01 0xbb 0x01 0x00 0x00 0x01 0x01 0x01 0xbc 0x00 0x00 0x00 0x01 0x00 0x00 0xbd 0x00 0x00 0x00 0x01 0x00 0x00 0xbe 0x00 0x00 0x00 0x01 0x00 0x00 0xbf 0x00 0x00 0x00 0x01 0x00 0x00 0xc0 0x00 0x00 0x00 0x01 0x00 0x00 0xc1 0x00 0x00 0x00 0x01 0x00 0x00 0xc2 0x00 0x00 0x00 0x01 0x00 0x00 0xc3 0x00 0x00 0x00 0x01 0x00 0x00 0xc4 0x00 0x00 0x00 0x01 0x00 0x00 0xc5 0x00 0x00 0x00 0x01 0x00 0x00 0xc6 0x00 0x00 0x00 0x01 0x00 0x00 0xc7 0x00 0x00 0x00 0x01 0x00 0x00 0xc8 0x00 0x00 0x00 0x01 0x00 0x00 0xc9 0x00 0x00 0x00 0x01 0x00 0x00 0xca 0x00 0x00 0x00 0x01 0x00 0x00 0xcb 0x00 0x00 0x00 0x01 0x00 0x00 0xcc 0x00 0x00 0x00 0x01 0x00 0x00 0xcd 0x00 0x00 0x00 0x01 0x00 0x00 0xce 0x00 0x00 0x00 0x01 0x00 0x00 0xcf 0x00 0x00 0x00 0x01 0x00 0x00 0xd0 0x00 0x00 0x00 0x01 0x00 0x00 0xd1 0x00 0x00 0x00 0x01 0x00 0x00 0xd2 0x00 0x00 0x00 0x01 0x00 0x00 0xd3 0x00 0x00 0x00 0x01 0x00 0x00 0xd4 0x00 0x00 0x00 0x01 0x00 0x00 0xd5 0x00 0x00 0x00 0x01 0x00 0x00 0xd6 0x00 0x00 0x00 0x01 0x00 0x00 0xd7 0x00 0x00 0x00 0x01 0x00 0x00 0xd8 0x00 0x00 0x00 0x01 0x00 0x00 0xd9 0x00 0x00 0x00 0x01 0x00 0x00 0xda 0x00 0x00 0x00 0x01 0x00 0x00 0xdb 0x00 0x00 0x00 0x01 0x00 0x00 0xdc 0x00 0x00 0x00 0x01 0x00 0x00 0xdd 0x00 0x00 0x00 0x01 0x00 0x00>;
		};
	};

	fragment@35 {
		target = <0xffffffff>;

		__overlay__ {
			interrupt-parent = <0xffffffff>;
			interrupts = <0x00 0x08>;
			status = "okay";
		};
	};

	fragment@36 {
		target = <0xffffffff>;

		__overlay__ {
			interrupt-parent = <0xffffffff>;
			interrupts = <0x04 0x08>;
			status = "okay";
		};
	};

	fragment@37 {
		target = <0xffffffff>;

		__overlay__ {
			interrupt-parent = <0xffffffff>;
			interrupts = <0x06 0x08>;
			status = "okay";
		};
	};

	fragment@38 {
		target = <0xffffffff>;

		__overlay__ {
			interrupt-parent = <0xffffffff>;
			interrupts = <0x09 0x02>;
			status = "okay";
		};
	};

	fragment@39 {
		target = <0xffffffff>;

		__overlay__ {
			interrupt-parent = <0xffffffff>;
			interrupts = <0x53 0x01>;
			status = "okay";
		};
	};

	fragment@40 {
		target = <0xffffffff>;

		__overlay__ {
			compatible = "mediatek,md1_sim1_hot_plug_eint-eint";
			interrupts = <0x00 0x08>;
			debounce = <0x00 0x186a0>;
			dedicated = <0x00 0x00>;
			src_pin = <0x00 0x01>;
			sockettype = <0x00 0x00>;
			status = "okay";
		};
	};

	fragment@41 {
		target = <0xffffffff>;

		__overlay__ {
			compatible = "mediatek,md1_sim2_hot_plug_eint-eint";
			interrupts = <0x01 0x08>;
			debounce = <0x01 0x186a0>;
			dedicated = <0x01 0x00>;
			src_pin = <0x01 0x02>;
			sockettype = <0x01 0x00>;
			status = "okay";
		};
	};

	fragment@42 {
		target = <0xffffffff>;

		__overlay__ {
			mediatek,key-debounce = <0x400>;
			mediatek,sw-pwrkey = <0x74>;
			mediatek,hw-pwrkey = <0x08>;
			mediatek,sw-rstkey = <0x73>;
			mediatek,hw-rstkey = <0x11>;
			mediatek,use-extend-type = <0x00>;
			mediatek,hw-map-num = <0x48>;
			mediatek,hw-init-map = <0x72 0x00 0x00 0x00 0x00 0x00 0x00 0x00 0x00 0x00 0x00 0x00 0x00 0x00 0x00 0x00 0x00 0x00 0x00 0x00 0x00 0x00 0x00 0x00 0x00 0x00 0x00 0x00 0x00 0x00 0x00 0x00 0x00 0x00 0x00 0x00 0x00 0x00 0x00 0x00 0x00 0x00 0x00 0x00 0x00 0x00 0x00 0x00 0x00 0x00 0x00 0x00 0x00 0x00 0x00 0x00 0x00 0x00 0x00 0x00 0x00 0x00 0x00 0x00 0x00 0x00 0x00 0x00 0x00 0x00 0x00 0x00>;
			mediatek,pwrkey-eint-gpio = <0x00>;
			mediatek,pwkey-gpio-din = <0x00>;
			mediatek,hw-dl-key0 = <0x11>;
			mediatek,hw-dl-key1 = <0x00>;
			mediatek,hw-dl-key2 = <0x08>;
			mediatek,hw-recovery-key = <0x11>;
			mediatek,hw-factory-key = <0x00>;
			status = "okay";
		};
	};

	__symbols__ {
		camera_pins_cam0_rst_0 = "/fragment@0/__overlay__/cam0@0";
		camera_pins_cam0_rst_1 = "/fragment@0/__overlay__/cam0@1";
		camera_pins_cam0_pnd_0 = "/fragment@0/__overlay__/cam0@2";
		camera_pins_cam0_pnd_1 = "/fragment@0/__overlay__/cam0@3";
		camera_pins_cam1_rst_0 = "/fragment@0/__overlay__/cam1@0";
		camera_pins_cam1_rst_1 = "/fragment@0/__overlay__/cam1@1";
		camera_pins_cam1_pnd_0 = "/fragment@0/__overlay__/cam1@2";
		camera_pins_cam1_pnd_1 = "/fragment@0/__overlay__/cam1@3";
		camera_pins_cam3_rst_0 = "/fragment@0/__overlay__/cam3@0";
		camera_pins_cam3_rst_1 = "/fragment@0/__overlay__/cam3@1";
		camera_pins_cam3_pnd_0 = "/fragment@0/__overlay__/cam3@2";
		camera_pins_cam3_pnd_1 = "/fragment@0/__overlay__/cam3@3";
		camera_pins_cam2_rst_0 = "/fragment@0/__overlay__/cam2@0";
		camera_pins_cam2_rst_1 = "/fragment@0/__overlay__/cam2@1";
		camera_pins_cam2_pnd_0 = "/fragment@0/__overlay__/cam2@2";
		camera_pins_cam2_pnd_1 = "/fragment@0/__overlay__/cam2@3";
		camera_pins_cam0_mclk_off = "/fragment@0/__overlay__/camera_pins_cam0_mclk_off";
		camera_pins_cam0_mclk_2ma = "/fragment@0/__overlay__/camera_pins_cam0_mclk_2ma";
		camera_pins_cam0_mclk_4ma = "/fragment@0/__overlay__/camera_pins_cam0_mclk_4ma";
		camera_pins_cam0_mclk_6ma = "/fragment@0/__overlay__/camera_pins_cam0_mclk_6ma";
		camera_pins_cam0_mclk_8ma = "/fragment@0/__overlay__/camera_pins_cam0_mclk_8ma";
		camera_pins_cam1_mclk_off = "/fragment@0/__overlay__/camera_pins_cam1_mclk_off";
		camera_pins_cam1_mclk_2ma = "/fragment@0/__overlay__/camera_pins_cam1_mclk_2ma";
		camera_pins_cam1_mclk_4ma = "/fragment@0/__overlay__/camera_pins_cam1_mclk_4ma";
		camera_pins_cam1_mclk_6ma = "/fragment@0/__overlay__/camera_pins_cam1_mclk_6ma";
		camera_pins_cam1_mclk_8ma = "/fragment@0/__overlay__/camera_pins_cam1_mclk_8ma";
		camera_pins_cam3_mclk_off = "/fragment@0/__overlay__/camera_pins_cam3_mclk_off";
		camera_pins_cam3_mclk_2ma = "/fragment@0/__overlay__/camera_pins_cam3_mclk_2ma";
		camera_pins_cam3_mclk_4ma = "/fragment@0/__overlay__/camera_pins_cam3_mclk_4ma";
		camera_pins_cam3_mclk_6ma = "/fragment@0/__overlay__/camera_pins_cam3_mclk_6ma";
		camera_pins_cam3_mclk_8ma = "/fragment@0/__overlay__/camera_pins_cam3_mclk_8ma";
		camera_pins_cam2_mclk_off = "/fragment@0/__overlay__/camera_pins_cam2_mclk_off";
		camera_pins_cam2_mclk_2ma = "/fragment@0/__overlay__/camera_pins_cam2_mclk_2ma";
		camera_pins_cam2_mclk_4ma = "/fragment@0/__overlay__/camera_pins_cam2_mclk_4ma";
		camera_pins_cam2_mclk_6ma = "/fragment@0/__overlay__/camera_pins_cam2_mclk_6ma";
		camera_pins_cam2_mclk_8ma = "/fragment@0/__overlay__/camera_pins_cam2_mclk_8ma";
		camera_pins_cam0_vcamio_0 = "/fragment@0/__overlay__/cam0@vcam0";
		camera_pins_cam0_vcamio_1 = "/fragment@0/__overlay__/cam0@vcam1";
		camera_pins_cam0_vcamd_0 = "/fragment@0/__overlay__/cam0@vcam2";
		camera_pins_cam0_vcamd_1 = "/fragment@0/__overlay__/cam0@vcam3";
		camera_pins_cam0_vcama1_0 = "/fragment@0/__overlay__/cam0@vcam4";
		camera_pins_cam0_vcama1_1 = "/fragment@0/__overlay__/cam0@vcam5";
		camera_pins_cam0_vcama_0 = "/fragment@0/__overlay__/cam0@vcam6";
		camera_pins_cam0_vcama_1 = "/fragment@0/__overlay__/cam0@vcam7";
		camera_pins_cam1_vcamio_0 = "/fragment@0/__overlay__/cam1@vcam0";
		camera_pins_cam1_vcamio_1 = "/fragment@0/__overlay__/cam1@vcam1";
		camera_pins_cam1_vcamd_0 = "/fragment@0/__overlay__/cam1@vcam2";
		camera_pins_cam1_vcamd_1 = "/fragment@0/__overlay__/cam1@vcam3";
		camera_pins_cam1_vcama1_0 = "/fragment@0/__overlay__/cam1@vcam4";
		camera_pins_cam1_vcama1_1 = "/fragment@0/__overlay__/cam1@vcam5";
		camera_pins_cam1_vcama_0 = "/fragment@0/__overlay__/cam1@vcam6";
		camera_pins_cam1_vcama_1 = "/fragment@0/__overlay__/cam1@vcam7";
		camera_pins_cam3_vcamio_0 = "/fragment@0/__overlay__/cam3@vcam0";
		camera_pins_cam3_vcamio_1 = "/fragment@0/__overlay__/cam3@vcam1";
		camera_pins_cam3_vcamd_0 = "/fragment@0/__overlay__/cam3@vcam2";
		camera_pins_cam3_vcamd_1 = "/fragment@0/__overlay__/cam3@vcam3";
		camera_pins_cam3_vcama_0 = "/fragment@0/__overlay__/cam3@vcam4";
		camera_pins_cam3_vcama_1 = "/fragment@0/__overlay__/cam3@vcam5";
		camera_pins_cam2_vcamio_0 = "/fragment@0/__overlay__/cam2@vcam0";
		camera_pins_cam2_vcamio_1 = "/fragment@0/__overlay__/cam2@vcam1";
		camera_pins_cam2_vcamd_0 = "/fragment@0/__overlay__/cam2@vcam2";
		camera_pins_cam2_vcamd_1 = "/fragment@0/__overlay__/cam2@vcam3";
		camera_pins_cam2_vcama_0 = "/fragment@0/__overlay__/cam2@vcam4";
		camera_pins_cam2_vcama_1 = "/fragment@0/__overlay__/cam2@vcam5";
		camera_pins_default = "/fragment@0/__overlay__/camdefault";
		mtk_camera_eeprom3 = "/fragment@2/__overlay__/camera_eeprom3@50";
		camera_sub_two_mtk = "/fragment@2/__overlay__/camera_sub_two@31";
		mtk_camera_eeprom2 = "/fragment@3/__overlay__/camera_eeprom2@51";
		camera_main_two_mtk = "/fragment@3/__overlay__/camera_main_two@37";
		mtk_camera_eeprom1 = "/fragment@4/__overlay__/camera_eeprom1@52";
		camera_sub_mtk = "/fragment@4/__overlay__/camera_sub@20";
		mtk_camera_eeprom0 = "/fragment@5/__overlay__/camera_eeprom0@50";
		camera_main_mtk = "/fragment@5/__overlay__/camera_main@20";
		camera_main = "/fragment@6/__overlay__/camera_main";
		camera_sub = "/fragment@6/__overlay__/camera_sub";
		camera_main_two = "/fragment@6/__overlay__/camera_main_two";
		camera_sub_two = "/fragment@6/__overlay__/camera_sub_two";
		spi_default = "/fragment@8/__overlay__/spi_default";
		spi_cs_mode_set = "/fragment@8/__overlay__/fpsensor_cs_set@gpio31";
		spi_cs_gpio_high = "/fragment@8/__overlay__/fpsensor_cs_gpio_high@gpio31";
		spi_cs_gpio_low = "/fragment@8/__overlay__/fpsensor_cs_gpio_low@gpio31";
		spi_mi_mode_set = "/fragment@8/__overlay__/fpsensor_mi_set@gpio33";
		spi_mo_mode_set = "/fragment@8/__overlay__/fpsensor_mo_set@gpio32";
		spi_clk_mode_set = "/fragment@8/__overlay__/fpsensor_clk_set@gpio30";
		finger_rst_high = "/fragment@8/__overlay__/fpsensor_rst_high@gpio102";
		finger_rst_low = "/fragment@8/__overlay__/fpsensor_rst_low@gpio10";
		finger_eint_as_int = "/fragment@8/__overlay__/fpsensor_eint@gpio8";
		mtkfb_pins_lcd_bias_enp1 = "/fragment@12/__overlay__/lcd_bias_enp1_gpio";
		mtkfb_pins_lcd_bias_enp0 = "/fragment@12/__overlay__/lcd_bias_enp0_gpio";
		mtkfb_pins_lcd_bias_enn1 = "/fragment@12/__overlay__/lcd_bias_enn1_gpio";
		mtkfb_pins_lcd_bias_enn0 = "/fragment@12/__overlay__/lcd_bias_enn0_gpio";
		mtkfb_pins_lcm_rst_out1_gpio = "/fragment@12/__overlay__/lcm_rst_out1_gpio";
		mtkfb_pins_lcm_rst_out0_gpio = "/fragment@12/__overlay__/lcm_rst_out0_gpio";
		mtkfb_pins_lcm_dsi_te = "/fragment@12/__overlay__/lcm_dsi_te";
		panel_in1 = "/fragment@15/__overlay__/panel1@0/port/endpoint";
		dsi_out = "/fragment@15/__overlay__/ports/port/endpoint";
		gps_pins_default = "/fragment@16/__overlay__/gps_default";
		gps_l1_lna_pins_ol = "/fragment@16/__overlay__/gps_l1_lna@0";
		gps_l1_lna_pins_dsp_ctrl = "/fragment@16/__overlay__/gps_l1_lna@1";
		gps_l1_lna_pins_oh = "/fragment@16/__overlay__/gps_l1_lna@2";
		gps_l5_lna_pins_ol = "/fragment@16/__overlay__/gps_l5_lna@0";
		gps_l5_lna_pins_dsp_ctrl = "/fragment@16/__overlay__/gps_l5_lna@1";
		gps_l5_lna_pins_oh = "/fragment@16/__overlay__/gps_l5_lna@2";
		lm3643 = "/fragment@19/__overlay__/lm3643@63";
		fl_core_0 = "/fragment@19/__overlay__/lm3643@63/flash@0/port@0/endpoint";
		fl_core_1 = "/fragment@19/__overlay__/lm3643@63/flash@1/port@1/endpoint";
		camaf_main_gpio_on = "/fragment@20/__overlay__/camaf_main@0";
		camaf_main_gpio_off = "/fragment@20/__overlay__/camaf_main@1";
		flashlight_0 = "/fragment@21/__overlay__/port@0/endpoint";
		flashlight_1 = "/fragment@21/__overlay__/port@1/endpoint";
		camera_main_af_mtk = "/fragment@22/__overlay__/camera_main_af@0c";
		camera_main_two_af_mtk = "/fragment@23/__overlay__/camera_main_two_af@0d";
		camera_main_three_af_mtk = "/fragment@23/__overlay__/camera_main_three_af@72";
		speaker_amp = "/fragment@27/__overlay__/aw87xxx_pa@5C";
		i2c_lcd_bias_mtk = "/fragment@27/__overlay__/i2c_lcd_bias@3e";
	};

	__fixups__ {
		pio = "/fragment@0:target:0\0/fragment@8:target:0\0/fragment@9/__overlay__:interrupt-parent:0\0/fragment@10/__overlay__/sc2150-pd@4e:sc2150,intr-gpio:0\0/fragment@12:target:0\0/fragment@15/__overlay__/panel1@0:reset-gpios:0\0/fragment@15/__overlay__/panel1@0:bias-gpios:0\0/fragment@15/__overlay__/panel1@0:bias-gpios:12\0/fragment@16:target:0\0/fragment@18/__overlay__/focaltech@0:interrupt-parent:0\0/fragment@18/__overlay__/focaltech@0:focaltech,reset-gpio:0\0/fragment@18/__overlay__/focaltech@0:focaltech,irq-gpio:0\0/fragment@20:target:0\0/fragment@27/__overlay__/aw87xxx_pa@5C:reset-gpio:0\0/fragment@28/__overlay__/sec-nfc@27:sec-nfc,ven-gpio:0\0/fragment@28/__overlay__/sec-nfc@27:sec-nfc,firm-gpio:0\0/fragment@28/__overlay__/sec-nfc@27:sec-nfc,irq-gpio:0\0/fragment@28/__overlay__/sec-nfc@27:sec-nfc,clk_req-gpio:0\0/fragment@29/__overlay__/sc8551-charger@66:sc,sc8551,irq-gpio:0\0/fragment@32/__overlay__:flash-en-gpio:0\0/fragment@32/__overlay__:flash-sel-gpio:0\0/fragment@33/__overlay__:GPIO_SIM1_HOT_PLUG:0\0/fragment@33/__overlay__:GPIO_SIM2_HOT_PLUG:0\0/fragment@33/__overlay__:GPIO_SIM1_SCLK:0\0/fragment@33/__overlay__:GPIO_SIM1_SRST:0\0/fragment@33/__overlay__:GPIO_SIM1_SIO:0\0/fragment@33/__overlay__:GPIO_SIM2_SCLK:0\0/fragment@33/__overlay__:GPIO_SIM2_SRST:0\0/fragment@33/__overlay__:GPIO_SIM2_SIO:0\0/fragment@35/__overlay__:interrupt-parent:0\0/fragment@36/__overlay__:interrupt-parent:0\0/fragment@37/__overlay__:interrupt-parent:0\0/fragment@38/__overlay__:interrupt-parent:0\0/fragment@39/__overlay__:interrupt-parent:0";
		kd_camera_hw1 = "/fragment@1:target:0";
		i2c9 = "/fragment@2:target:0";
		i2c2 = "/fragment@3:target:0\0/fragment@23:target:0";
		i2c4 = "/fragment@4:target:0";
		i2c8 = "/fragment@5:target:0\0/fragment@22:target:0";
		thermal_zones = "/fragment@6:target:0";
		spi0 = "/fragment@7:target:0";
		mt6358_vio28_reg = "/fragment@7/__overlay__/chipone@0:vdd_fps-supply:0";
		fpsensor = "/fragment@9:target:0";
		i2c3 = "/fragment@10:target:0\0/fragment@28:target:0";
		mtk_leds = "/fragment@11:target:0";
		disp_pwm = "/fragment@11/__overlay__/backlight:pwms:0";
		mtkfb = "/fragment@13:target:0";
		dispsys_config = "/fragment@14:target:0";
		dsi0 = "/fragment@15:target:0";
		gps = "/fragment@17:target:0";
		spi3 = "/fragment@18:target:0";
		i2c6 = "/fragment@19:target:0\0/fragment@25:target:0\0/fragment@27:target:0";
		mtk_composite_v4l2_1 = "/fragment@21:target:0";
		camera_af_hw_node = "/fragment@24:target:0";
		i2c5 = "/fragment@26:target:0";
		i2c7 = "/fragment@29:target:0";
		sound = "/fragment@30:target:0";
		pdc = "/fragment@31:target:0";
		flashlights_aw3641e = "/fragment@32:target:0";
		gpio_usage_mapping = "/fragment@33:target:0";
		gpio = "/fragment@34:target:0";
		mrdump_ext_rst = "/fragment@35:target:0";
		subpmic_pmu_eint = "/fragment@36:target:0";
		smart_pa = "/fragment@37:target:0";
		touch = "/fragment@38:target:0";
		dsi_te = "/fragment@39:target:0";
		md1_sim1_hot_plug_eint = "/fragment@40:target:0";
		md1_sim2_hot_plug_eint = "/fragment@41:target:0";
		keypad = "/fragment@42:target:0";
	};

	__local_fixups__ {

		fragment@1 {

			__overlay__ {
				pinctrl-0 = <0x00>;
				pinctrl-1 = <0x00>;
				pinctrl-2 = <0x00>;
				pinctrl-3 = <0x00>;
				pinctrl-4 = <0x00>;
				pinctrl-5 = <0x00>;
				pinctrl-6 = <0x00>;
				pinctrl-7 = <0x00>;
				pinctrl-8 = <0x00>;
				pinctrl-9 = <0x00>;
				pinctrl-10 = <0x00>;
				pinctrl-11 = <0x00>;
				pinctrl-12 = <0x00>;
				pinctrl-13 = <0x00>;
				pinctrl-14 = <0x00>;
				pinctrl-15 = <0x00>;
				pinctrl-16 = <0x00>;
				pinctrl-17 = <0x00>;
				pinctrl-18 = <0x00>;
				pinctrl-19 = <0x00>;
				pinctrl-20 = <0x00>;
				pinctrl-21 = <0x00>;
				pinctrl-22 = <0x00>;
				pinctrl-23 = <0x00>;
				pinctrl-24 = <0x00>;
				pinctrl-25 = <0x00>;
				pinctrl-26 = <0x00>;
				pinctrl-27 = <0x00>;
				pinctrl-28 = <0x00>;
				pinctrl-29 = <0x00>;
				pinctrl-30 = <0x00>;
				pinctrl-31 = <0x00>;
				pinctrl-32 = <0x00>;
				pinctrl-33 = <0x00>;
				pinctrl-34 = <0x00>;
				pinctrl-35 = <0x00>;
				pinctrl-36 = <0x00>;
				pinctrl-37 = <0x00>;
				pinctrl-38 = <0x00>;
				pinctrl-39 = <0x00>;
				pinctrl-40 = <0x00>;
				pinctrl-41 = <0x00>;
				pinctrl-42 = <0x00>;
				pinctrl-43 = <0x00>;
				pinctrl-44 = <0x00>;
				pinctrl-45 = <0x00>;
				pinctrl-46 = <0x00>;
				pinctrl-47 = <0x00>;
				pinctrl-48 = <0x00>;
				pinctrl-49 = <0x00>;
				pinctrl-50 = <0x00>;
				pinctrl-51 = <0x00>;
				pinctrl-52 = <0x00>;
				pinctrl-53 = <0x00>;
				pinctrl-54 = <0x00>;
				pinctrl-55 = <0x00>;
				pinctrl-56 = <0x00>;
				pinctrl-57 = <0x00>;
				pinctrl-58 = <0x00>;
				pinctrl-59 = <0x00>;
				pinctrl-60 = <0x00>;
				pinctrl-61 = <0x00>;
				pinctrl-62 = <0x00>;
			};
		};

		fragment@6 {

			__overlay__ {

				camera_main {
					thermal-sensors = <0x00>;
				};

				camera_sub {
					thermal-sensors = <0x00>;
				};

				camera_main_two {
					thermal-sensors = <0x00>;
				};

				camera_sub_two {
					thermal-sensors = <0x00>;
				};
			};
		};

		fragment@9 {

			__overlay__ {
				pinctrl-0 = <0x00>;
				pinctrl-1 = <0x00>;
				pinctrl-2 = <0x00>;
				pinctrl-3 = <0x00>;
				pinctrl-4 = <0x00>;
				pinctrl-5 = <0x00>;
				pinctrl-6 = <0x00>;
				pinctrl-7 = <0x00>;
				pinctrl-8 = <0x00>;
				pinctrl-9 = <0x00>;
			};
		};

		fragment@13 {

			__overlay__ {
				pinctrl-0 = <0x00>;
				pinctrl-1 = <0x00>;
				pinctrl-2 = <0x00>;
				pinctrl-3 = <0x00>;
				pinctrl-4 = <0x00>;
				pinctrl-5 = <0x00>;
				pinctrl-6 = <0x00>;
			};
		};

		fragment@14 {

			__overlay__ {
				pinctrl-0 = <0x00>;
				pinctrl-1 = <0x00>;
				pinctrl-2 = <0x00>;
			};
		};

		fragment@15 {

			__overlay__ {

				panel1@0 {

					port {

						endpoint {
							remote-endpoint = <0x00>;
						};
					};
				};

				ports {

					port {

						endpoint {
							remote-endpoint = <0x00>;
						};
					};
				};
			};
		};

		fragment@17 {

			__overlay__ {
				pinctrl-0 = <0x00>;
				pinctrl-1 = <0x00>;
				pinctrl-2 = <0x00>;
				pinctrl-3 = <0x00>;
				pinctrl-4 = <0x00>;
				pinctrl-5 = <0x00>;
				pinctrl-6 = <0x00>;
			};
		};

		fragment@19 {

			__overlay__ {

				lm3643@63 {

					flash@0 {

						port@0 {

							endpoint {
								remote-endpoint = <0x00>;
							};
						};
					};

					flash@1 {

						port@1 {

							endpoint {
								remote-endpoint = <0x00>;
							};
						};
					};
				};
			};
		};

		fragment@21 {

			__overlay__ {

				port@0 {

					endpoint {
						remote-endpoint = <0x00>;
					};
				};

				port@1 {

					endpoint {
						remote-endpoint = <0x00>;
					};
				};
			};
		};

		fragment@24 {

			__overlay__ {
				pinctrl-0 = <0x00>;
				pinctrl-1 = <0x00>;
			};
		};

		fragment@30 {

			__overlay__ {

				mediatek,speaker-codec {
					sound-dai = <0x00>;
				};
			};
		};
	};
};
